// SPDX-License-Identifier: GPL-2.0-or-later OR MIT

#include "mt7621_fcj_g-ax1800-f.dtsi"

/ {
	compatible = "fcj,g-ax1800-f", "mediatek,mt7621-soc";
	model = "FCJ G-AX1800-F";
};

&gsw {
	mediatek,portmap = "lllwl";
	status = "okay";
};
